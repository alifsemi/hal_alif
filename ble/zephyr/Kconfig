## ble/zephyr/Kconfig
```kconfig
# Copyright 2023 Alif Semiconductor

# Bluetooth related configurations

if ALIF_BLE_HOST

menu "Alif BLE host stack"

config ALIF_BLE_HOST_THREAD_PRIORITY
	int "Priority for thread running the BLE host stack"
	default 5

config ALIF_BLE_HOST_THREAD_STACKSIZE
	int "Stack size for thread running the BLE host stack"
	default 4096

config ALIF_BLE_HOST_ADDL_PRF_HEAPSIZE
	int "Additional heap size required for supported profiles"
	default 0
	help
	  Depending on the profiles enabled in the stack the profile
	  heap size allocated needs to be adjusted.

config ALIF_BLE_HOST_ADDL_ENV_HEAPSIZE
	int "Additional heap size required for supported environments"
	default 0
	help
	  Depending on the environments enabled in the stack the environment
	  heap size allocated needs to be adjusted.

endmenu

endif
```

## common/zephyr/Kconfig
```kconfig
menuconfig ALIF_PM_LINK_LAYER
	bool "Alif link layer configuration"
	default y if HAS_ALIF_BLE_802154_LINK_LAYER
	depends on HAS_ALIF_POWER_MANAGER
	depends on HAS_ALIF_SE_SERVICES

if ALIF_PM_LINK_LAYER

config ALIF_PM_LE_CODED_PHY_500
	int "LE Coded PHY 500 Kbps selection"
	default 0

config ALIF_PM_DFT_SLAVE_MD
	int "Default MD bit used by slave when sending a data packet on a BLE connection"
	default 0

config ALIF_PM_CH_CLASS_REP_INTV
	int "Channel classification reporting interval (in ms) (0 if not used)"
	default 0

# config ALIF_PM_BD_ADDRESS
# 	string "Local Bd Address"
# 	default {0x01, 0x23, 0x45, 0x67, 0x89, 0xAB}

config ALIF_PM_ACTIVITY_MOVE_CONFIG
	int "Activity Move Configuration (enables/disables activity move for BLE connections and BT (e)SCO links)"
	default 1

config ALIF_PM_SCAN_EXT_ADV
	int "Enable/disable scanning for extended advertising PDUs"
	default 1

config ALIF_PM_RSSI_HIGH_THR
	int "RSSI high threshold"
	default -40

config ALIF_PM_RSSI_LOW_THR
	int "RSSI low threshold"
	default -60

config ALIF_PM_SLEEP_ENABLE
	int "Enable sleep mode"
	default 1

config ALIF_PM_EXT_WAKEUP_ENABLE
	int "Enable External Wakeup"
	default 1

config ALIF_PM_ENABLE_CH_ASSESSMENT
	int "Enable/disable channel assessment for BLE"
	default 1

config ALIF_PM_RSSI_INTERF_THR
	int "RSSI interference threshold"
	default -70

config ALIF_EXT_WAKEUP_TIME
	int "External wakeup time needed (us)"
	default 25000

config ALIF_OSC_WAKEUP_TIME
	int "Oscilator enable wakeup time needed (us)"
	default 25000

config ALIF_RM_WAKEUP_TIME
	int "Radio wakeup time needed (us)"
	default 625

config ALIF_EXT_WARMBOOT_WAKEUP_TIME
	int "Warmboot wakeup time. Time limit between light / deep sleep (us)"
	default 32000

config ALIF_MAX_SLEEP_CLOCK_DRIFT
	int "Max drift of sleep clock in PPM"
	default 250
	range 20 65535

config ALIF_MAX_ACTIVE_CLOCK_DRIFT
	int "Max drift of active clock in PPM"
	default 250
	range 20 255

config ALIF_HPA_MODE
	bool "High Power Amplifier for Alif controller"

config ALIF_TX_MAX
	int
	default 10 if ALIF_HPA_MODE
	default 4

config ALIF_TX_MIN
	int
	default -25 if ALIF_HPA_MODE
	default -31

config ALIF_TX_MAX_POWER
	int "Set maximum allowed TX power in dBm"
	default ALIF_TX_MAX
	range ALIF_TX_MIN ALIF_TX_MAX

config ALIF_EDGE_LIMIT_ON
	bool # "Limit power on edge channels"
	default y if BOARD_ALIF_B1_DK
	default n

config ALIF_EDGE_LOW_CHANNEL
	int "First channel the edge limit is not applied"
	default 0

config ALIF_EDGE_HIGH_CHANNEL
	int "Last channel the edge limit is not applied"
	default 38 if BOARD_ALIF_B1_DK
	default 39

config ALIF_EDGE_CHANNEL_POWER_LIMIT
	int "Set maximum allowed TX power in dBm for edges"
	default 0 if BOARD_ALIF_B1_DK
	default ALIF_TX_MAX_POWER
	range ALIF_TX_MIN ALIF_TX_MAX_POWER

endif # ALIF_PM_LINK_LAYER
```

## drivers/jpeg/Kconfig
```kconfig
config USE_ALIF_JPEG_SW_LIB
	bool "Use prebuilt JPEG SW library"
	depends on VIDEO_JPEG_HANTRO_VC9000E
	help
	  Link the prebuilt JPEG SW static library (.a) instead of
	  compiling from source. The correct library variant is automatically
	  selected based on ZEPHYR_TOOLCHAIN_VARIANT.
```

## ieee802154/Kconfig
```kconfig
# 802.15.4 related configurations

config IEEE802154_ALIF_SUPPORT
	bool "include 802.15.4 support"
	depends on HAS_ALIF_BLE_802154_LINK_LAYER
	help
	  This option enables Alif Semiconductor's 802.15.4 HW adaptation.

if IEEE802154_ALIF_SUPPORT

config IEEE802154_ALIF_TX_ENCRYPT
	bool "IEEE 802.15.4 TX packet handler and encryption"
	depends on MBEDTLS
	default y if OPENTHREAD_THREAD_VERSION_1_2
	default y if OPENTHREAD_THREAD_VERSION_1_3
	help
	  This option is enables Alif Semiconductor's 802.15.4 Tx packet handler for encryption.

endif
```

## lc3/zephyr/Kconfig
```kconfig
# LC3 codec related configurations

menuconfig ALIF_ROM_LC3_CODEC
	bool "Enable usage of the LC3 codec in ROM"
	depends on HAS_ALIF_BLE_ROM_IMAGE
	select FPU
	select HAVE_CUSTOM_LINKER_SCRIPT
	help
	  Allow the LC3 codec in ROM to be used.
```

## se_services/zephyr/Kconfig
```kconfig
# Copyright (C) 2023 Alif Semiconductor - All Rights Reserved.
# Use, distribution and modification of this code is permitted under the
# terms stated in the Alif Semiconductor Software License Agreement
#
# You should have received a copy of the Alif Semiconductor Software
# License Agreement with this file. If not, please write to:
# contact@alifsemi.com, or visit: https://alifsemi.com/license
config SE_SERVICE_INIT_PRIORITY
	int "SE service MHUv2 nodes Init priority"
	depends on ARM_MHUV2
	default 45
	help
	  SE service MHUv2 nodes initialization priority.

config SE_SERVICE_RF_CORE_FREQUENCY
	int "RF Core clock frequency"
	default 4
	help
	  Valid values are 0, 4, 12.

config ALIF_SE_DTS_RUN_PROFILE
	bool "Apply SE run profile from DTS at boot and resume"
	depends on ARM_MHUV2
	depends on $(dt_nodelabel_enabled,aipm_run)
	default y
	help
	  When enabled, se_service reads child nodes from the aipm-run DTS
	  node and applies the matching run profile automatically:
	    - At cold boot, from se_service_mhuv2_nodes_init()
	      (PRE_KERNEL_1, CONFIG_SE_SERVICE_INIT_PRIORITY, default 45).
	    - In pre_device_resume PM notifier on wakeup from any PM state,
	      before pm_resume_devices() is called.

config ALIF_SE_DTS_OFF_PROFILE
	bool "Apply SE off profile from DTS on PM state entry"
	depends on ARM_MHUV2
	depends on $(dt_nodelabel_enabled,aipm_off)
	default y
	help
	  When enabled, se_service reads child nodes from the aipm-off DTS
	  node and applies the matching off_profile_t before the CPU enters
	  a low-power state (SUSPEND_TO_RAM or SOFT_OFF). The profile is
	  applied in the state_entry PM notifier, before the CPU is
	  clock-gated or powered down.

	  The aipm-off node is disabled by default in SoC DTSIs. Enable it
	  in a board overlay alongside the power-state nodes it supports.
```

## zephyr/Kconfig
```kconfig
# BLE host stack related configurations

if BT

choice BT_STACK_SELECTION
	prompt "Bluetooth Stack Selection"
	default BT_HCI

	help
	  Select the Bluetooth stack to compile.

	config BT_HCI
		bool "HCI-based"
		help
		  HCI-based stack with optional host & controller parts and an
		  HCI driver in between.

	config BT_CUSTOM
		bool "Alif's BLE Host stack"
		select ALIF_BLE_HOST
		help
		  Alif Semiconductor BLE boards have host stack on ROM and by selecting
		  this option it becomes available as a build option.
endchoice

config ALIF_BLE_HOST
	bool
	depends on HAS_ALIF_BLE_ROM_IMAGE
	select FPU
	select HAVE_CUSTOM_LINKER_SCRIPT
	select USE_ALIF_HAL_UTIMER
	select RING_BUFFER
	help
	  This option enables Alif Semiconductor's BLE Host Stack.

endif # BT

if HAVE_CUSTOM_LINKER_SCRIPT

config CUSTOM_LINKER_SCRIPT
	depends on HAS_ALIF_BLE_ROM_IMAGE
	string
	default "${ZEPHYR_ALIF_MODULE_DIR}/linker_add_rom_symbols.ld"

endif # HAVE_CUSTOM_LINKER_SCRIPT

# BLE/LC3 ROM API source selection.
#
# Alif BLE and LC3 run from code resident in the SoC ROM. This HAL does not ship
# that ROM; it ships the means to call into it: the public API headers, the ROM
# symbol-address linker scripts and the host-stack patch overlay. By default the
# set bundled in this HAL is used, selected from the device tree ble-rom-version
# property. An out-of-tree module can instead supply these files by selecting
# ALIF_BLE_ROM_API_EXTERNAL and pointing the options below at them, so a module
# can carry its own API headers and symbol addresses while reusing this HAL's
# build and link machinery.
config ALIF_BLE_ROM_API_EXTERNAL
	bool "Take the BLE/LC3 ROM API and symbol addresses from an out-of-tree module"
	depends on HAS_ALIF_BLE_ROM_IMAGE
	help
	  Use the BLE/LC3 ROM API headers, ROM symbol-address linker scripts and
	  host-stack patch supplied by another module instead of the set bundled in
	  this HAL. The on-chip ROM itself is unchanged; only the interface used to
	  call into it is provided. When enabled, set ALIF_BLE_ROM_API_DIR,
	  ALIF_LC3_ROM_API_DIR, ALIF_BLE_ROM_SYMBOLS_LDS and ALIF_LC3_ROM_SYMBOLS_LDS
	  to the providing module's files. Typically selected from a board's
	  Kconfig.defconfig.

if ALIF_BLE_ROM_API_EXTERNAL

config ALIF_BLE_ROM_API_DIR
	string "External BLE ROM API directory"
	help
	  Directory added with add_subdirectory(). Must contain a CMakeLists.txt
	  that exposes the BLE public API headers, links the host-stack patch
	  (rom_ble_stack.patch.elf) and wires the patch sections (see this HAL's
	  ble/v1_2 for the layout).

config ALIF_LC3_ROM_API_DIR
	string "External LC3 ROM API directory"
	help
	  Directory added with add_subdirectory(). Must contain a CMakeLists.txt
	  that exposes the LC3 public API headers.

config ALIF_BLE_ROM_SYMBOLS_LDS
	string "External BLE ROM symbol-address linker script"
	help
	  Absolute path to the BLE ROM symbol-address linker script
	  (rom_symbols_ble.lds), #included by linker_add_rom_symbols.ld.

config ALIF_LC3_ROM_SYMBOLS_LDS
	string "External LC3 ROM symbol-address linker script"
	help
	  Absolute path to the LC3 ROM symbol-address linker script
	  (rom_symbols_lc3.lds), #included by linker_add_rom_symbols.ld.

endif # ALIF_BLE_ROM_API_EXTERNAL

rsource "../se_services/zephyr/Kconfig"
rsource "../common/zephyr/Kconfig"
rsource "../lc3/zephyr/Kconfig"
rsource "../ble/zephyr/Kconfig"
rsource "../drivers/isp/Kconfig"
rsource "../drivers/jpeg/Kconfig"
```
